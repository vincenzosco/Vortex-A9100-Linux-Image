## configs/vortex86_a9100_defconfig
```kconfig
# DM&P Vortex86 A9100 (i486-compatible) Custom Linux Image
# Architecture: i486 (32-bit x86), 300MHz, FPU-less
# Target: Embedded industrial SBC with GUI + package manager
#
# Build with: make vortex86_a9100_defconfig && make

# Architecture
BR2_x86_i486=y
BR2_i386=y
BR2_X86_CPU_HAS_I486=y

# Toolchain
BR2_TOOLCHAIN_BUILDROOT=y
BR2_TOOLCHAIN_BUILDROOT_MUSL=y
BR2_TOOLCHAIN_BUILDROOT_CXX=y
BR2_TOOLCHAIN_BUILDROOT_SSP=n
BR2_PACKAGE_HOST_LINUX_HEADERS_CUSTOM_5_10=y

# Kernel
BR2_LINUX_KERNEL=y
BR2_LINUX_KERNEL_CUSTOM_VERSION=y
BR2_LINUX_KERNEL_CUSTOM_VERSION_VALUE="5.10.220"
BR2_LINUX_KERNEL_DEFCONFIG="i386"
BR2_LINUX_KERNEL_CONFIG_FRAGMENT_FILES="board/dmp/vortex86_a9100/linux.config"
BR2_LINUX_KERNEL_LZMA=y
BR2_LINUX_KERNEL_IMAGE_TARGET="bzImage"

# Global patch directory for kernel CMPXCHG8B emulation and other patches
BR2_GLOBAL_PATCH_DIR="board/dmp/vortex86_a9100/patches"

# Bootloader
BR2_TARGET_GRUB2=y
BR2_TARGET_GRUB2_BUILTIN_MODULES_PC="bios part_msdos ext2 fat"
BR2_TARGET_GRUB2_INSTALL_TOOLS=y

# Filesystem images
BR2_TARGET_ROOTFS_EXT2=y
BR2_TARGET_ROOTFS_EXT2_4=y
BR2_TARGET_ROOTFS_EXT2_SIZE="512M"
BR2_TARGET_ROOTFS_EXT2_LABEL="vortex-root"
BR2_TARGET_ROOTFS_TAR=y

# System configuration
BR2_SYSTEM_BIN_SH_BUSYBOX=y
BR2_TARGET_GENERIC_HOSTNAME="vortex-a9100"
BR2_TARGET_GENERIC_ISSUE="Vortex86 A9100 Embedded Linux"
BR2_INIT_BUSYBOX=y
BR2_ROOTFS_OVERLAY="board/dmp/vortex86_a9100/overlay"
BR2_ROOTFS_POST_BUILD_SCRIPT="board/dmp/vortex86_a9100/post-build.sh"
BR2_ROOTFS_POST_IMAGE_SCRIPT="board/dmp/vortex86_a9100/post-image.sh"

# Core utilities
BR2_PACKAGE_BUSYBOX=y
BR2_PACKAGE_BUSYBOX_CONFIG_FRAGMENT_FILES="board/dmp/vortex86_a9100/busybox.config"
BR2_PACKAGE_UTIL_LINUX=y
BR2_PACKAGE_UTIL_LINUX_MOUNT=y
BR2_PACKAGE_UTIL_LINUX_FSCK=y
BR2_PACKAGE_UTIL_LINUX_EJECT=n
BR2_PACKAGE_E2FSPROGS=y
BR2_PACKAGE_DOSFSTOOLS=y

# Package manager
BR2_PACKAGE_OPKG=y
BR2_PACKAGE_OPKG_SIGNATURE_VERIFICATION=n

# Networking
BR2_PACKAGE_DHCPCD=y
BR2_PACKAGE_WPA_SUPPLICANT=y
BR2_PACKAGE_NET_TOOLS=y
BR2_PACKAGE_IPTABLES=n
BR2_PACKAGE_OPENSSH=y
BR2_PACKAGE_LIBCURL=y
BR2_PACKAGE_LIBCURL_CURL=y
BR2_PACKAGE_WGET=y

# Shell and text editing
BR2_PACKAGE_NANO=y
BR2_PACKAGE_VIM=n
BR2_PACKAGE_MC=n

# Display server (X11)
BR2_PACKAGE_XORG7=y
BR2_PACKAGE_XSERVER_XORG_SERVER=y
BR2_PACKAGE_XSERVER_XORG_SERVER_MODEDSETTINGS=n
BR2_PACKAGE_XDRIVER_XF86_INPUT_MOUSE=y
BR2_PACKAGE_XDRIVER_XF86_INPUT_EVDEV=y
BR2_PACKAGE_XDRIVER_XF86_VIDEO_VESA=y
BR2_PACKAGE_XDRIVER_XF86_VIDEO_FBDEV=y
BR2_PACKAGE_XDRIVER_XF86_VIDEO_MODESETTING=n
BR2_PACKAGE_XAPP_XINIT=y
BR2_PACKAGE_XAPP_XSETROOT=y
BR2_PACKAGE_XAPP_XCALC=n
BR2_PACKAGE_XAPP_XCLOCK=y
BR2_PACKAGE_XAPP_XTERM=y
BR2_PACKAGE_XAPP_XWININFO=n
BR2_PACKAGE_XFONT_FONT_MISC_MISC=y
BR2_PACKAGE_XFONT_FONT_CURSOR_MISC=y
BR2_PACKAGE_XFONT_FONT_ALIASES=y
BR2_PACKAGE_XFONT_FONT_UTIL=y
BR2_PACKAGE_XLIB_LIBXFT=y
BR2_PACKAGE_XLIB_LIBXINERAMA=n
BR2_PACKAGE_XLIB_LIBXRENDER=y

# Window manager - Openbox (lightweight, standard in Buildroot)
# Config is installed via post-build.sh to ~/.config/openbox/rc.xml
BR2_PACKAGE_OPENBOX=y

# Desktop applications - lightweight
BR2_PACKAGE_PCManFM=n
BR2_PACKAGE_LEAFFPAD=n
BR2_PACKAGE_GVIEWER=n

# Graphics libraries (minimal)
BR2_PACKAGE_LIBPNG=y
BR2_PACKAGE_JPEG=y
BR2_PACKAGE_FREETYPE=y
BR2_PACKAGE_FONTCONFIG=y
BR2_PACKAGE_CAIRO=n
BR2_PACKAGE_PANGO=n
BR2_PACKAGE_LIBGTK2=n
BR2_PACKAGE_LIBGTK3=n

# Terminal
BR2_PACKAGE_RXVT_UNICODE=n
BR2_PACKAGE_LINUX_FRAMEBUFFER=y

# Development tools (minimal, for package building)
BR2_PACKAGE_MAKE=y
BR2_PACKAGE_PKGCONF=y
BR2_PACKAGE_GCC_TARGET=n

# Utilities
BR2_PACKAGE_LSOF=y
BR2_PACKAGE_STRACE=y
BR2_PACKAGE_HTOP=y
BR2_PACKAGE_FILE=y
BR2_PACKAGE_LESSTIF=n
BR2_PACKAGE_USBUTILS=y

# Audio (minimal - most Vortex86 boards don't have audio)
BR2_PACKAGE_ALSA_UTILS=n

# Date/time
BR2_PACKAGE_NTPDATE=y
BR2_PACKAGE_HWDATA=y

# Enable getty on serial console and VGA
BR2_TARGET_GENERIC_GETTY=y
BR2_TARGET_GENERIC_GETTY_PORT="ttyS0"
BR2_TARGET_GENERIC_GETTY_BAUDRATE="115200"
BR2_TARGET_GENERIC_GETTY_TERM="linux"
```
